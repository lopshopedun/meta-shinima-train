## conf/layer.conf
```bitbake
# We have a conf and classes directory, append to BBPATH
BBPATH .= ":${LAYERDIR}"

# We have a recipes directory, add to BBFILES
BBFILES += "${LAYERDIR}/recipes-*/*/*.bb ${LAYERDIR}/recipes-*/*/*.bbappend"

BBFILE_COLLECTIONS += "shinima-train"
BBFILE_PATTERN_shinima-train := "^${LAYERDIR}/"
BBFILE_PRIORITY_shinima-train = "9"

BBMASK .= "|meta-networking/recipes-protocols/net-snmp/net-snmp_5.7.2.1.bb"
BBMASK .= "|poky/meta/recipes-connectivity/openssh/openssh_6.7p1.bb"
```
